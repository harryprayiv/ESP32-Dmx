## firmware/main/Kconfig.projbuild
```kconfig
menu "ESP32 DMX controller"

    config DMX_UART_NUM
        int "UART that drives the RS-485 transceiver"
        range 1 2
        default 1
        help
            UART0 is the serial console, so it is not offered. UART2 does not
            exist on every chip; the build fails if the choice is not valid.

    config DMX_TX_GPIO
        int "GPIO wired to the transceiver's DI pin"
        range 0 10 if IDF_TARGET_ESP32C3
        default 4 if IDF_TARGET_ESP32C3
        default 17
        help
            On the ESP32-C3 only GPIO 0 to 10 are offered. 12 to 17 are the
            flash, 18 and 19 are USB, 20 and 21 are the serial console.
            Of 0 to 10, leave 2, 8 and 9 alone: the chip reads them at reset
            to choose its boot mode.

    config DMX_REDE_GPIO
        int "GPIO wired to the transceiver's RE and DE pins, or -1"
        range -1 10 if IDF_TARGET_ESP32C3
        default 5 if IDF_TARGET_ESP32C3
        default 21
        help
            Driven high while transmitting. Use -1 if the hardware enables
            the driver on its own. The ESP32-C3 limits are the same as for
            the DI pin.

    config DMX_AP_SSID
        string "Wi-Fi access point name"
        default "esp32dmx"

    config DMX_AP_PASSWORD
        string "Wi-Fi access point password (8 to 63 characters)"
        default "change-me-512"

    config DMX_AP_CHANNEL
        int "Wi-Fi channel"
        range 1 11
        default 6

endmenu
```
